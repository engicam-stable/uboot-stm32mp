## board/engicam-st/stm32mp1-ugea/Kconfig
```kconfig
if TARGET_UGEA_STM32MP1

config SYS_BOARD
	default "stm32mp1-ugea"

config SYS_VENDOR
	default "engicam-st"

config SYS_CONFIG_NAME
	default "stm32mp1-ugea"

config CMD_STBOARD
	bool "stboard - command for OTP board information"
	default y
	help
	  This compile the stboard command to
	  read and write the board in the OTP.

endif
 
```

## board/engicam/stm32mp1-icore/Kconfig
```kconfig
if TARGET_ICORE_STM32MP1

config SYS_BOARD
	default "stm32mp1-icore"

config SYS_VENDOR
	default "engicam"

config SYS_CONFIG_NAME
	default "stm32mp1-icore"

source "board/engicam/common/Kconfig"
endif
```

## board/engicam/stm32mp1-ugea/Kconfig
```kconfig
if TARGET_UGEA_STM32MP1

config SYS_BOARD
	default "stm32mp1-ugea"

config SYS_VENDOR
	default "engicam"

config SYS_CONFIG_NAME
	default "stm32mp1-ugea"

source "board/engicam/common/Kconfig"
endif
```
